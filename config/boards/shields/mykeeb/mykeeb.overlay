
/ {
    chosen {
        zmk,kscan = &default_kscan;
    };

    default_kscan: kscan {
        compatible = "zmk,kscan-gpio-direct";
        label = "default_kscan";

        input-gpios = 
            <&gpio0 1 (GPIO_ACTIVE_HIGH | GPIO_PULL_DOWN)>,
            <&gpio0 0 (GPIO_ACTIVE_HIGH | GPIO_PULL_DOWN)>,
            <&gpio0 2 (GPIO_ACTIVE_HIGH | GPIO_PULL_DOWN)>,
            <&gpio0 3 (GPIO_ACTIVE_HIGH | GPIO_PULL_DOWN)>,
            <&gpio0 4 (GPIO_ACTIVE_HIGH | GPIO_PULL_DOWN)>,
            <&gpio0 5 (GPIO_ACTIVE_HIGH | GPIO_PULL_DOWN)>,
            <&gpio0 6 (GPIO_ACTIVE_HIGH | GPIO_PULL_DOWN)>,
            <&gpio0 7 (GPIO_ACTIVE_HIGH | GPIO_PULL_DOWN)>,
            <&gpio0 8 (GPIO_ACTIVE_HIGH | GPIO_PULL_DOWN)>,
            <&gpio0 9 (GPIO_ACTIVE_HIGH | GPIO_PULL_DOWN)>,
            <&gpio0 10 (GPIO_ACTIVE_HIGH | GPIO_PULL_DOWN)>,
            <&gpio0 11 (GPIO_ACTIVE_HIGH | GPIO_PULL_DOWN)>,
            <&gpio0 12 (GPIO_ACTIVE_HIGH | GPIO_PULL_DOWN)>,
            <&gpio0 13 (GPIO_ACTIVE_HIGH | GPIO_PULL_DOWN)>,
            <&gpio0 14 (GPIO_ACTIVE_HIGH | GPIO_PULL_DOWN)>,
            <&gpio0 15 (GPIO_ACTIVE_HIGH | GPIO_PULL_DOWN)>,
            <&gpio0 16 (GPIO_ACTIVE_HIGH | GPIO_PULL_DOWN)>;
    };
};